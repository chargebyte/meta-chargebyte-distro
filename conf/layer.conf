## conf/layer.conf
```bitbake
# We have a conf and classes directory, add to BBPATH
BBPATH .= ":${LAYERDIR}"

# We have recipes-* directories, add to BBFILES
BBFILES += "${LAYERDIR}/recipes-*/*/*.bb \
            ${LAYERDIR}/recipes-*/*/*.bbappend \
            ${LAYERDIR}/packagegroups/*.bb \
            ${LAYERDIR}/packagegroups/*.bbappend \
            ${LAYERDIR}/bundles/*.bb"

BBFILE_COLLECTIONS += "chargebyte-distro"
BBFILE_PATTERN_chargebyte-distro = "^${LAYERDIR}/"
BBFILE_PRIORITY_chargebyte-distro = "6"

LAYERDEPENDS_chargebyte-distro = "chargebyte"

LAYERSERIES_COMPAT_chargebyte-distro = "kirkstone"
```

## conf/machine/evachargese.conf
```bitbake
#@TYPE: Machine
#@NAME: in-tech EVAcharge SE Platform
#@SOC: i.MX28
#@DESCRIPTION: Machine configuration for in-tech EVAcharge SE Boards
#@MAINTAINER: Michael Heimpold <michael.heimpold@in-tech.com>

MACHINEOVERRIDES =. "mxs:mx28:"

include conf/machine/include/imx-base.inc
include conf/machine/include/tune-arm926ejs.inc

UBOOT_MACHINE = "evacharge-se_defconfig"

KERNEL_DEVICETREE = "imx28-evachargese.dtb"

PREFERRED_PROVIDER_u-boot = "u-boot-imx"
PREFERRED_PROVIDER_virtual/bootloader = "u-boot-imx"
PREFERRED_PROVIDER_virtual/kernel = "linux-imx"

SERIAL_CONSOLES = "115200;ttyAMA0"

RAUC_BUNDLE_COMPATIBLE = "I2SE EVAcharge SE"
```

## conf/machine/tarragon.conf
```bitbake
#@TYPE: Machine
#@NAME: in-tech Tarragon Platform
#@SOC: i.MX6ULL
#@DESCRIPTION: Machine configuration for in-tech Tarragon Boards
#@MAINTAINER: Michael Heimpold <michael.heimpold@in-tech.com>

MACHINEOVERRIDES =. "mx6:mx6ull:"

include conf/machine/include/imx-base.inc
include conf/machine/include/tune-cortexa7.inc

UBOOT_MACHINE = "tarragon_config"

KERNEL_DEVICETREE = "imx6ull-tarragon-master.dtb imx6ull-tarragon-slave.dtb imx6ull-tarragon-micro.dtb imx6ull-tarragon-slavext.dtb"

PREFERRED_PROVIDER_u-boot = "u-boot-imx"
PREFERRED_PROVIDER_virtual/bootloader = "u-boot-imx"
PREFERRED_PROVIDER_virtual/kernel = "linux-imx"

SERIAL_CONSOLES = "115200;ttymxc3"

MACHINE_FIRMWARE_remove = "firmware-imx-epdc"

RAUC_BUNDLE_COMPATIBLE = "I2SE Tarragon"
```
